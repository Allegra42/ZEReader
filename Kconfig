## boards/zereader/zereader_rev1/Kconfig.defconfig
```kconfig
# SPDX-FileCopyrightText: 2025 Anna-Lena Marx <mail@marx.engineer>
#
# SPDX-License-Identifier: MPL-2.0

if BOARD_ZEREADER_REV1

config USB_SELF_POWERED
	default n

endif # BOARD_ZEREADER_REV1
```

## boards/zereader/zereader_rev1/Kconfig.zereader_rev1
```kconfig
# SPDX-FileCopyrightText: 2025 Anna-Lena Marx <mail@marx.engineer>
#
# SPDX-License-Identifier: MPL-2.0

config BOARD_ZEREADER_REV1
    select SOC_RP2350A_M33 if BOARD_ZEREADER_REV1
```

## boards/zereader/zereader_rev1/board.yml
```yaml
# SPDX-FileCopyrightText: 2025 Anna-Lena Marx <mail@marx.engineer>
#
# SPDX-License-Identifier: MPL-2.0

board:
  name: zereader_rev1
  full_name: ZEReader rev 1
  vendor: zereader
  socs:
    - name: rp2350a
```
