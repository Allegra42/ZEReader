## boards/zereader/zereader_rev2/Kconfig.defconfig
```kconfig
# SPDX-FileCopyrightText: 2025 Anna-Lena Marx <mail@marx.engineer>
#
# SPDX-License-Identifier: MPL-2.0

if BOARD_ZEREADER_REV2

config USB_SELF_POWERED
	default n

config BUTTON_ONOFF
	bool "Is the ZEReader pcb equipped with an of/off push button?"
	default y

endif # BOARD_ZEREADER_REV2
```

## boards/zereader/zereader_rev2/board.yml
```yaml
# SPDX-FileCopyrightText: 2025 Anna-Lena Marx <mail@marx.engineer>
#
# SPDX-License-Identifier: MPL-2.0

board:
  name: zereader_rev2
  full_name: ZEReader rev 2
  vendor: zereader
  socs:
    - name: rp2350a
```
