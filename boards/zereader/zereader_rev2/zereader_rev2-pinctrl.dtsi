// SPDX-FileCopyrightText: 2025 Anna-Lena Marx <mail@marx.engineer>
//
// SPDX-License-Identifier: MPL-2.0

#include <zephyr/dt-bindings/pinctrl/rpi-pico-rp2350a-pinctrl.h>

#include "../common/zereader_pi-pico-common.dtsi"